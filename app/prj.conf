## CMakeLists.txt
```
# Copyright (c) 2025 Antmicro <www.antmicro.com>
#
# SPDX-License-Identifier: Apache-2.0

cmake_minimum_required(VERSION 3.20.0)
find_package(Zephyr REQUIRED HINTS $ENV{ZEPHYR_BASE})

project(app)

kenning_gen_model_header("${CMAKE_CURRENT_BINARY_DIR}/src/model_data.h")
kenning_add_board_repl_target()

include_directories("${CMAKE_CURRENT_BINARY_DIR}/src")
target_sources(app PRIVATE src/main.c)
```

## Kconfig
```
# Copyright (c) 2025 Antmicro <www.antmicro.com>
#
# SPDX-License-Identifier: Apache-2.0

menu "Zephyr"
source "Kconfig.zephyr"
endmenu

module = APP
module-str = app
source "subsys/logging/Kconfig.template.log_config"
```

## west.yml
```
# Copyright (c) 2025 Antmicro <www.antmicro.com>
#
# SPDX-License-Identifier: Apache-2.0

manifest:
  remotes:
    - name: zephyrproject-rtos
      url-base: https://github.com/zephyrproject-rtos

    - name: antmicro
      url-base: https://github.com/antmicro

  projects:
    - name: kenning-zephyr-runtime
      remote: antmicro
      revision: main
      import:
        path-allowlist:
          - dlpack
          - tvm
          - tflite-micro

    - name: zephyr
      remote: zephyrproject-rtos
      revision: v4.3.0
      import:
        path-allowlist:
          - modules/debug/*
          - modules/hal/*
          - modules/lib/*
          - modules/tee/tf-m/*

    - name: zephelin
      remote: antmicro
      revision: main
      west-commands: west/west-commands.yml
```

## prj.conf
```kconfig
# Copyright (c) 2025 Antmicro <www.antmicro.com>
#
# SPDX-License-Identifier: Apache-2.0

CONFIG_KENNING_INFERENCE_LIB=y
CONFIG_KENNING_ML_RUNTIME_STUB=y
CONFIG_KENNING_COMMUNICATION_PROTOCOL_NONE=y

CONFIG_SERIAL=y
CONFIG_FPU=y
CONFIG_BUILD_WITH_TFM=n
CONFIG_HEAP_MEM_POOL_SIZE=2048

CONFIG_LOG=y
CONFIG_LOG_MODE_MINIMAL=y
CONFIG_LOG_SIMPLE_MSG_OPTIMIZE=y
CONFIG_LOG_DEFAULT_LEVEL=3
CONFIG_LOG_MAX_LEVEL=3
CONFIG_APP_LOG_LEVEL_DBG=n

CONFIG_MODEL_LOG_LEVEL_DBG=y
CONFIG_RUNTIME_WRAPPER_LOG_LEVEL_DBG=y
```

## ai8x_c.conf
```kconfig
# Copyright (c) 2025 Antmicro <www.antmicro.com>
#
# SPDX-License-Identifier: Apache-2.0

CONFIG_KENNING_ML_RUNTIME_AI8X=y

CONFIG_CLOCK_CONTROL=y

CONFIG_NEWLIB_LIBC=y
CONFIG_NEWLIB_LIBC_NANO=y
CONFIG_NEWLIB_LIBC_FLOAT_PRINTF=y
CONFIG_MAIN_STACK_SIZE=4096
```

## tflite.conf
```kconfig
# Copyright (c) 2025 Antmicro <www.antmicro.com>
#
# SPDX-License-Identifier: Apache-2.0

CONFIG_KENNING_INFERENCE_LIB=y
CONFIG_KENNING_COMMUNICATION_PROTOCOL_NONE=y
CONFIG_KENNING_ML_RUNTIME_TFLITE=y
CONFIG_KENNING_TFLITE_BUFFER_SIZE=80

CONFIG_CPP=y
CONFIG_STD_CPP17=y
CONFIG_NEWLIB_LIBC=y
CONFIG_NEWLIB_LIBC_NANO=y
CONFIG_NEWLIB_LIBC_FLOAT_PRINTF=y
CONFIG_MAIN_STACK_SIZE=4096
```

## tvm.conf
```kconfig
# Copyright (c) 2025 Antmicro <www.antmicro.com>
#
# SPDX-License-Identifier: Apache-2.0

CONFIG_KENNING_INFERENCE_LIB=y
CONFIG_KENNING_COMMUNICATION_PROTOCOL_NONE=y
CONFIG_KENNING_ML_RUNTIME_TVM=y
CONFIG_KENNING_TVM_HEAP_SIZE=66

CONFIG_KENNING_TVM_MODEL_GEN=y

CONFIG_TIMING_FUNCTIONS=y
CONFIG_TEST_RANDOM_GENERATOR=y

CONFIG_CPP=y
CONFIG_NEWLIB_LIBC=y
CONFIG_NEWLIB_LIBC_NANO=y
CONFIG_NEWLIB_LIBC_FLOAT_PRINTF=y
CONFIG_MAIN_STACK_SIZE=4096
```

## boards/max78002evkit_max78002_m4.overlay
```dts
&clk_ipll {
        status = "okay";
};
```

## src/main.c
```c
/*
 * Copyright (c) 2025 Antmicro <www.antmicro.com>
 *
 * SPDX-License-Identifier: Apache-2.0
 */

#include <kenning_inference_lib/core/model.h>
#include <kenning_inference_lib/core/utils.h>

#include "model_data.h"

#include <zephyr/kernel.h>
#include <zephyr/logging/log.h>

#if defined(CONFIG_ZPL)
#include <zpl.h>
#endif

LOG_MODULE_REGISTER(app, CONFIG_APP_LOG_LEVEL);

#define ITER_EVAL_INTERVAL_MS 2000

int main(void)
{
    status_t status = STATUS_OK;
    uint8_t *model_input = NULL;
    uint8_t *model_output = NULL;
    size_t model_input_size = 0;
    size_t model_output_size = 0;
    int64_t timer_sec = 0;
    int64_t timer_start = 0;
    int64_t timer_end = 0;
    int64_t timer_iterations = 0;
    int32_t iterations = 0;

    do
    {
        LOG_INF("Initializing model");
        // initialize model
        status = model_init();
        if (STATUS_OK != status)
        {
            LOG_ERR("Model initialization error 0x%x (%s)", status, get_status_str(status));
            break;
        }

        LOG_INF("Loading model_spec");
        // load model structure
        status = model_load_struct((uint8_t *)&model_spec, sizeof(model_spec_t));
        BREAK_ON_ERROR_LOG(status, "Model struct load error 0x%x (%s)", status, get_status_str(status));

        LOG_INF("Loading model_data");
        // load model weights
        status = model_load_weights(model_data, model_data_len);
        BREAK_ON_ERROR_LOG(status, "Model weights load error 0x%x (%s)", status, get_status_str(status));

        // allocate buffer for input
        model_get_input_size(&model_input_size);
        model_input = k_aligned_alloc(32, model_input_size);

        // allocate buffer for output
        model_get_output_size(&model_output_size);
        model_output = k_aligned_alloc(32, model_output_size);

        LOG_INF("Model is ready\n");

        while (true)
        {
            for (size_t i = 0; i < model_input_size; ++i)
            {
                model_input[i] = rand() & 0xff;
            }

            status = model_load_input(model_input, model_input_size);
            BREAK_ON_ERROR_LOG(status, "Model input load error 0x%x (%s)", status, get_status_str(status));

            timer_start = k_uptime_get();

            status = model_run();
            BREAK_ON_ERROR_LOG(status, "Model run error 0x%x (%s)", status, get_status_str(status));

            timer_end = k_uptime_get();

            status = model_get_output(model_output_size, model_output, NULL);
            BREAK_ON_ERROR_LOG(status, "Model get output error 0x%x (%s)", status, get_status_str(status));

            timer_iterations += (timer_end - timer_start);
            ++iterations;

            if (timer_end - timer_sec >= ITER_EVAL_INTERVAL_MS)
            {
                LOG_INF("Number of iterations:         %d", iterations);
                LOG_INF("Total time:                   %lld ms", timer_end - timer_sec);
                LOG_INF("Total time (inference only):  %lld ms", timer_iterations);
                LOG_INF("Average inference time:       %f ms", ((double)timer_iterations) / iterations);
                LOG_INF("Iterations per second:        %f\n\n", iterations / (double)timer_iterations * 1000);
                iterations = 0;
                timer_iterations = 0;
                timer_sec = k_uptime_get();
            }
        }
    } while (0);

    if (IS_VALID_POINTER(model_output))
    {
        free(model_output);
    }
    if (IS_VALID_POINTER(model_input))
    {
        free(model_input);
    }

    return 0;
}
```
